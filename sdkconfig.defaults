## sdkconfig.defaults
```kconfig
# Rust often needs a bit of an extra main task stack size compared to C (the default is 3K)
CONFIG_ESP_MAIN_TASK_STACK_SIZE=30720

# Use this to set FreeRTOS kernel tick frequency to 1000 Hz (100 Hz by default).
# This allows to use 1 ms granularity for thread sleeps (10 ms by default).
CONFIG_FREERTOS_HZ=1000
CONFIG_ESP_DEFAULT_CPU_FREQ_MHZ_240=y
CONFIG_ESP_DEFAULT_CPU_FREQ_MHZ=240
CONFIG_ESP32S3_DEFAULT_CPU_FREQ_240=y
CONFIG_ESP32S3_DEFAULT_CPU_FREQ_MHZ=240


# Workaround for https://github.com/espressif/esp-idf/issues/7631
#CONFIG_MBEDTLS_CERTIFICATE_BUNDLE=n
#CONFIG_MBEDTLS_CERTIFICATE_BUNDLE_DEFAULT_FULL=n

CONFIG_HTTPD_WS_SUPPORT=y
CONFIG_VFS_MAX_COUNT=20
CONFIG_SPIRAM_MALLOC_ALWAYSINTERNAL=8

CONFIG_COMPILER_OPTIMIZATION_CHECKS_SILENT=y
CONFIG_LOG_MAXIMUM_LEVEL=1
CONFIG_LOG_DEFAULT_LEVEL=1

#CONFIG_I2C_ENABLE_SLAVE_DRIVER_VERSION_2=y
CONFIG_I2C_SKIP_LEGACY_CONFLICT_CHECK=y

CONFIG_SPIRAM=y
CONFIG_SPIRAM_USE=y
CONFIG_SPIRAM_USE_MALLOC=y
CONFIG_SPIRAM_BOOT_INIT=y
CONFIG_SPIRAM_MODE_OCT=y
CONFIG_SPIRAM_SPEED_80M=y
CONFIG_SPIRAM_ALLOW_BSS_SEG_EXTERNAL_MEMORY=y

CONFIG_SR_NSN_NSNET2=y
CONFIG_SR_VADN_VADNET1_MEDIUM=y
CONFIG_SR_WN_WN9_HIESP=y
CONFIG_SR_MN_CN_MULTINET5_RECOGNITION_QUANT8=y
CONFIG_CN_SPEECH_COMMAND_ID0="kai shi dui hua"
CONFIG_CN_SPEECH_COMMAND_ID1="jie shu dui hua"
CONFIG_CN_SPEECH_COMMAND_ID2="kai shi lu yin"
CONFIG_CN_SPEECH_COMMAND_ID3=""
CONFIG_CN_SPEECH_COMMAND_ID4=""
CONFIG_CN_SPEECH_COMMAND_ID5=""
CONFIG_CN_SPEECH_COMMAND_ID6=""
CONFIG_CN_SPEECH_COMMAND_ID7=""
CONFIG_CN_SPEECH_COMMAND_ID8=""
CONFIG_CN_SPEECH_COMMAND_ID9=""
CONFIG_CN_SPEECH_COMMAND_ID10=""
CONFIG_CN_SPEECH_COMMAND_ID11=""
CONFIG_CN_SPEECH_COMMAND_ID12=""
CONFIG_CN_SPEECH_COMMAND_ID13=""
CONFIG_CN_SPEECH_COMMAND_ID14=""
CONFIG_CN_SPEECH_COMMAND_ID15=""
CONFIG_CN_SPEECH_COMMAND_ID16=""
CONFIG_CN_SPEECH_COMMAND_ID17=""
CONFIG_CN_SPEECH_COMMAND_ID18=""
CONFIG_CN_SPEECH_COMMAND_ID19=""

CONFIG_BT_ENABLED=y
CONFIG_BT_BLE_ENABLED=y
CONFIG_BT_BLUEDROID_ENABLED=n
CONFIG_BT_NIMBLE_ENABLED=y
CONFIG_BT_NIMBLE_HOST_TASK_STACK_SIZE=7000

#CONFIG_BT_NIMBLE_NVS_PERSIST=y

CONFIG_ESPTOOLPY_FLASHSIZE_16MB=y

CONFIG_PARTITION_TABLE_CUSTOM=y
CONFIG_PARTITION_TABLE_CUSTOM_FILENAME="/workspace/partitions.csv"
```
